## firmware/components/capture/Kconfig
```kconfig
menu "Capture"

    config APP_CAPTURE_WARMUP_FRAMES
        int "Frames to discard before keeping one"
        range 0 10
        default 2
        help
            The first frames after the sensor starts are taken before
            auto-exposure settles. More frames give a better picture and a
            longer wake time.

    config APP_CAPTURE_JPEG_QUALITY
        int "JPEG quality (lower is better, 0-63)"
        range 4 63
        default 12

endmenu
```

## firmware/components/inference/Kconfig
```kconfig
menu "Inference"

    config APP_TENSOR_ARENA_KB
        int "Tensor arena size (KB)"
        range 32 4096
        default 512
        help
            Working memory for TensorFlow Lite Micro. Allocated from PSRAM when
            available, otherwise from internal RAM. The arena actually used is
            logged at start-up so this can be trimmed.

endmenu
```

## firmware/components/power/Kconfig
```kconfig
menu "Power and wake-up"

    config APP_PIR_GPIO
        int "PIR sensor output GPIO"
        range 0 21
        default 14
        help
            Must be an RTC-capable GPIO (0-21 on the ESP32-S3) that the camera
            does not use, so that it can wake the chip from deep sleep.
            See docs/HARDWARE.md.

    config APP_PIR_WARMUP_S
        int "PIR warm-up time after power-on (seconds)"
        range 0 300
        default 45
        help
            The PIR output is unreliable right after power-up. The device
            ignores it for this long after a cold boot.

    config APP_PIR_RECHECK_S
        int "Re-check interval while the PIR output stays high (seconds)"
        range 1 60
        default 3
        help
            After an event the PIR output can stay high for several seconds.
            Instead of staying awake, the device sleeps and wakes on a timer
            to check whether the output has dropped before re-arming it.

endmenu
```

## firmware/components/uplink/Kconfig
```kconfig
menu "Uplink (Wi-Fi and ingest service)"

    config APP_WIFI_SSID
        string "Wi-Fi SSID"
        default ""
        help
            Leave empty to run without a network: frames are captured,
            measured and discarded. Set with `idf.py menuconfig`; the value
            lives in sdkconfig, which is not committed.

    config APP_WIFI_PASSWORD
        string "Wi-Fi password"
        default ""

    config APP_INGEST_URL
        string "Ingest endpoint URL"
        default ""
        help
            Full URL of the events endpoint, for example
            http://192.168.1.10:8000/v1/events. https:// URLs are verified
            against the built-in certificate bundle.

    config APP_DEVICE_TOKEN
        string "Device token"
        default ""
        help
            Sent as a Bearer token. Must match the token the ingest service
            was started with.

    config APP_WIFI_CONNECT_TIMEOUT_MS
        int "Wi-Fi connect timeout (ms)"
        range 1000 60000
        default 10000

    config APP_HTTP_TIMEOUT_MS
        int "HTTP request timeout (ms)"
        range 1000 60000
        default 10000

endmenu
```

## firmware/main/Kconfig.projbuild
```kconfig
menu "Application"

    choice APP_MODE
        prompt "Operating mode"
        default APP_MODE_COLLECT

        config APP_MODE_COLLECT
            bool "Collect: upload every capture (dataset building)"

        config APP_MODE_INFER
            bool "Infer: classify on the device, upload what matters"

        config APP_MODE_BENCH
            bool "Bench: run the model on built-in test images and print results"
            help
                No camera, no sensor, no network. Used on the emulator and on
                the board to measure latency and check that the device gives
                the same answers as the PC.
    endchoice

    config APP_INFER_UPLOAD_BELOW_PCT
        int "Infer mode: also upload the image when confidence is below (percent)"
        depends on APP_MODE_INFER
        range 0 100
        default 70
        help
            Low-confidence captures are the most useful ones to label next.

    config APP_INFER_SAMPLE_EVERY
        int "Infer mode: upload every Nth image regardless of the result"
        depends on APP_MODE_INFER
        range 0 1000
        default 10
        help
            A random-ish sample of what the device sees, used to detect drift.
            0 disables sampling.

    config APP_BENCH_RUNS
        int "Bench mode: timed runs per image"
        depends on APP_MODE_BENCH
        range 1 100
        default 5

    config APP_BENCH_DUMP_GRAY
        bool "Bench mode: print the preprocessed image as hex"
        depends on APP_MODE_BENCH
        default n

endmenu
```
